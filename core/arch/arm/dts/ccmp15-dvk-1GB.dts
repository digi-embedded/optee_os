// SPDX-License-Identifier: (GPL-2.0+ OR BSD-3-Clause)
/*
 * Copyright (C) 2023-2025, Digi International Inc - All Rights Reserved
 */

/dts-v1/;

/* Digi ConnectCore CCMP15 DVK */
#include "ccmp15-dvk.dtsi"

/ {
	memory@c0000000 {
		device_type = "memory";
		reg = <0xC0000000 0x40000000>; /* 1 GiB */
	};

	reserved-memory {
		gpu_reserved: gpu@fa000000 {
			reg = <0xfa000000 0x4000000>;
			no-map;
		};
	};
};
